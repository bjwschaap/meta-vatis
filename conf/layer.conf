## conf/layer.conf
```bitbake
# We have a conf and classes directory, add to BBPATH
BBPATH .= ":${LAYERDIR}"

# We have recipes-* directories, add to BBFILES
BBFILES += "${LAYERDIR}/recipes-*/*/*.bb \
            ${LAYERDIR}/recipes-*/*/*.bbappend"

BBFILE_COLLECTIONS += "meta-vatis"
BBFILE_PATTERN_meta-vatis = "^${LAYERDIR}/"
BBFILE_PRIORITY_meta-vatis = "6"

LAYERDEPENDS_meta-vatis = "core"
LAYERSERIES_COMPAT_meta-vatis = "warrior zeus"
```
